## robot-mov/Kconfig
```kconfig
menu "Project options"

config ENCODER_CALIBRATION
    bool "Activate the compile for encoder calibration"
    default n
    help
        If y activate the encoder calibration project

config ESCS_CALIBRATION
    bool "Activate the compile for BLC motors calibration"
    default n
    help
        If y activate the BLC motors calibration

config TEST_WHEELS
    bool "Activate the compile for test wheelss"
    default n
    help
        If y activate the test wheels
config TEST_IMU
    bool "Activate the compile for test IMU"
    default n
    help
        If y activate the test IMU
config TEST_VEL_WHEEL
    bool "Activate the compile for test VEL in Wheels"
    default n
    help
        If y activate the test Vel in Wheels
endmenu
```
